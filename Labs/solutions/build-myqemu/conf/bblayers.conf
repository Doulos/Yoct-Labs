## Labs/solutions/build-myqemu/conf/bblayers.conf
```bitbake
# POKY_BBLAYERS_CONF_VERSION is increased each time build/conf/bblayers.conf
# changes incompatibly
POKY_BBLAYERS_CONF_VERSION = "2"

BBPATH = "${TOPDIR}"
BBFILES ?= ""

BBLAYERS ?= " \
  /home/usertest2/yocto/poky/meta \
  /home/usertest2/yocto/poky/meta-poky \
  /home/usertest2/yocto/poky/meta-yocto-bsp \
  /home/usertest2/yocto/layers/meta-training \
  /home/usertest2/yocto/layers/meta-custom \
  /home/usertest2/yocto/layers/meta-openembedded/meta-oe \
  /home/usertest2/yocto/layers/meta-openembedded/meta-python \
  /home/usertest2/yocto/layers/meta-openembedded/meta-networking \
  /home/usertest2/yocto/layers/meta-mybsp \
  /home/usertest2/yocto/build-myqemu/workspace \
  "
```

## Labs/solutions/layers/meta-mybsp/conf/layer.conf
```bitbake
# We have a conf and classes directory, add to BBPATH
BBPATH .= ":${LAYERDIR}"

# We have recipes-* directories, add to BBFILES
BBFILES += "${LAYERDIR}/recipes-*/*/*.bb \
            ${LAYERDIR}/recipes-*/*/*.bbappend"

BBFILE_COLLECTIONS += "meta-mybsp"
BBFILE_PATTERN_meta-mybsp = "^${LAYERDIR}/"
BBFILE_PRIORITY_meta-mybsp = "6"

LAYERDEPENDS_meta-mybsp = "core"
LAYERSERIES_COMPAT_meta-mybsp = "kirkstone"
```

## Labs/solutions/layers/meta-mybsp/conf/machine/myqemu.conf
```bitbake
#@TYPE: Machine
#@NAME: QEMU ARMv8 machine
#@DESCRIPTION: Machine configuration for running an ARMv8 system on QEMU

require conf/machine/include/arm/armv8a/tune-cortexa57.inc
###require conf/machine/include/qemu.inc

# Which bootloader?
PREFERRED_PROVIDER_virtual/bootloader ?= "u-boot"
# Which U-Boot config?
UBOOT_MACHINE ?= "qemu_arm64_defconfig"
# Make sure U-Boot is built
EXTRA_IMAGEDEPENDS += "virtual/bootloader"

# Build modules into image
MACHINE_ESSENTIAL_EXTRA_RRECOMMENDS += "hello-mod kernel-module-bluetooth"
# Make sure the modules are automatically loaded after boot
KERNEL_MODULE_AUTOLOAD += "bluetooth hello"

KERNEL_IMAGETYPE = "Image"

#UBOOT_MACHINE ?= "qemu_arm64_defconfig"
UBOOT_MACHINE ?= "myqemu_defconfig"

SERIAL_CONSOLES ?= "115200;ttyAMA0 115200;hvc0"
SERIAL_CONSOLES_CHECK = "${SERIAL_CONSOLES}"

# For runqemu
QB_SYSTEM_NAME = "qemu-system-aarch64"
QB_MACHINE = "-machine virt"
QB_CPU = "-cpu cortex-a57"
QB_SMP = "-smp 4"
QB_CPU_KVM = "-cpu host -machine gic-version=3"
# For graphics to work we need to define the VGA device as well as the necessary USB devices
QB_GRAPHICS = "-device virtio-gpu-pci"
QB_OPT_APPEND = "-device qemu-xhci -device usb-tablet -device usb-kbd"
# Virtio Networking support
QB_TAP_OPT = "-netdev tap,id=net0,ifname=@TAP@,script=no,downscript=no"
QB_NETWORK_DEVICE = "-device virtio-net-device,netdev=net0,mac=@MAC@"
# Virtio block device
QB_ROOTFS_OPT = "-drive id=disk0,file=@ROOTFS@,if=none,format=raw -device virtio-blk-device,drive=disk0"
# Virtio serial console
QB_SERIAL_OPT = "-device virtio-serial-device -chardev null,id=virtcon -device virtconsole,chardev=virtcon"
QB_TCPSERIAL_OPT = "-device virtio-serial-device -chardev socket,id=virtcon,port=@PORT@,host=127.0.0.1 -device virtconsole,chardev=virtcon"
PREFERRED_PROVIDER_virtual/xserver ?= "xserver-xorg"
PREFERRED_PROVIDER_virtual/egl ?= "mesa"
PREFERRED_PROVIDER_virtual/libgl ?= "mesa"
PREFERRED_PROVIDER_virtual/libgles1 ?= "mesa"
PREFERRED_PROVIDER_virtual/libgles2 ?= "mesa"
PREFERRED_PROVIDER_virtual/libgles3 ?= "mesa"

XSERVER ?= "xserver-xorg \
            ${@bb.utils.contains('DISTRO_FEATURES', 'opengl', 'mesa-driver-swrast xserver-xorg-extension-glx', '', d)} \
            xf86-video-fbdev \
            "

MACHINE_FEATURES = "alsa bluetooth usbgadget screen vfat"

MACHINEOVERRIDES =. "qemuall:"

IMAGE_FSTYPES += "tar.bz2 ext4"

# Don't include kernels in standard images
RDEPENDS:${KERNEL_PACKAGE_NAME}-base = ""

# Use a common kernel recipe for all QEMU machines
PREFERRED_PROVIDER_virtual/kernel ??= "linux-yocto"

EXTRA_IMAGEDEPENDS += "qemu-system-native qemu-helper-native:do_addto_recipe_sysroot"

# Provide the nfs server kernel module for all qemu images
KERNEL_FEATURES:append:pn-linux-yocto = " features/nfsd/nfsd-enable.scc"
KERNEL_FEATURES:append:pn-linux-yocto-rt = " features/nfsd/nfsd-enable.scc"

IMAGE_CLASSES += "qemuboot"
```
